## build/conf/bblayers.conf
```bitbake
# POKY_BBLAYERS_CONF_VERSION is increased each time build/conf/bblayers.conf
# changes incompatibly
POKY_BBLAYERS_CONF_VERSION = "2"

BBPATH = "${TOPDIR}"
BBFILES ?= ""

YOCTOROOT = "${@os.path.abspath(os.path.join("${TOPDIR}", os.pardir))}"

BBLAYERS ?= " \
  ${YOCTOROOT}/layers/third-party/poky/meta \
  ${YOCTOROOT}/layers/third-party/poky/meta-poky \
  ${YOCTOROOT}/layers/third-party/poky/meta-yocto-bsp \
  ${YOCTOROOT}/layers/third-party/meta-openembedded/meta-oe \
  ${YOCTOROOT}/layers/third-party/meta-raspberrypi \
  ${YOCTOROOT}/layers/third-party/meta-openembedded/meta-python \
  ${YOCTOROOT}/layers/third-party/meta-openembedded/meta-multimedia \
  ${YOCTOROOT}/layers/third-party/meta-openembedded/meta-networking \
  "
```
